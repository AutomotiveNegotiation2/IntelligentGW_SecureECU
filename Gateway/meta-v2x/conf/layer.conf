## Gateway/meta-v2x/conf/layer.conf
```bitbake
# We have a conf and classes directory, add to BBPATH
BBPATH .= ":${LAYERDIR}"

# We have recipes-* directories, add to BBFILES
BBFILES += "${LAYERDIR}/recipes-*/*/*.bb \
			${LAYERDIR}/recipes-*/*/*.bbappend"

BBFILE_COLLECTIONS += "v2x"
BBFILE_PATTERN_v2x = "^${LAYERDIR}/"
BBFILE_PRIORITY_v2x = "10"
```
