
SECTIONS
{
    .sbl_mcu_1_0_resetvector 	: {} palign(8) 		> MSMC3_MCU1_CPU0
    .text 	                    : {} palign(8) 		> MSMC3_MCU1_CPU0
    .rodata 	                : {} palign(8) 		> MSMC3_MCU1_CPU0
}

